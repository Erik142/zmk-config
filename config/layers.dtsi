#ifndef LAYERS_INCLUDED
#define LAYERS_INCLUDED

#define XXX &none
#define ___ &trans

#include "./layers/base.dtsi"
#include "./layers/colemak.dtsi"
#include "./layers/layers.dtsi"
#include "./layers/num.dtsi"
#include "./layers/sym.dtsi"
#include "./layers/media.dtsi"
#include "./layers/navigation.dtsi"
#include "./layers/mouse.dtsi"
#include "./layers/function.dtsi"
#include "./layers/bootloader.dtsi"

#endif
