#ifndef LAYER_NUM_INCLUDED
#define LAYER_NUM_INCLUDED

ZMK_LAYER(num,
		&kp ESC  &trans    &trans    &trans    &trans			&kp STAR &kp NUM_7 &kp NUM_8 &kp NUM_9 &trans 
		&kp LGUI  &kp LCTL    &kp LSHFT    &kp RALT    &kp LALT 		&plequal &kp NUM_4  &kp NUM_5 &kp NUM_6  &kp SLASH 
		&trans  &trans    &trans    &trans    &trans 			&kp MINUS &kp NUM_1 &kp NUM_2 &kp NUM_3  &kp NUM_0 
					    &trans  &trans			&trans &trans 
)

#endif
