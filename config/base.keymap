#include <behaviors.dtsi>
#include <dt-bindings/zmk/keys.h>
#include <dt-bindings/zmk/bt.h>

#include "zmk-helpers/helper.h"

#include "behaviors/settings.dtsi"
#include "behaviors/layer-defs.dtsi"
#include "behaviors/keys.dtsi"
#include "behaviors/combos.dtsi"
#include "behaviors/tap-dances.dtsi"
#include "behaviors/hold-taps.dtsi"
#include "behaviors/macros.dtsi"

#include "behaviors/layers.dtsi"
